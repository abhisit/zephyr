## boards/orangepi/board.yml
```yaml
board:
  name: opi5plus
  full_name: Orange Pi 5 Plus (4x Cortex-A76 and 4x Cortex-A55)
  vendor: orangepi
  socs:
  - name: rk3588
    variants:
    - name: smp
```

## boards/orangepi/opi5plus/board.yml
```yaml
board:
  name: opi5plus
  full_name: Orange Pi 5 Plus
  vendor: orangepi
  socs:
  - name: rk3588
    variants:
    - name: smp
```
